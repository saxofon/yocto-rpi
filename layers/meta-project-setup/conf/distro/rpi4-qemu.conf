## layers/meta-project-setup/conf/distro/rpi4-qemu.conf
```bitbake
require conf/distro/poky.conf

IMAGE_FEATURES_remove = "splash"
FEATURE_INSTALL_remove = "psplash-raspberrypi"
DISABLE_SPLASH = "1"
DISTRO_FEATURES_remove = " 3g bluetooth irda nfc x11 wayland"

#PREFERRED_PROVIDER_virtual/kernel = "linux-raspberrypi-rt"
EXTRA_IMAGE_FEATURES += "debug-tweaks"
#EXTRA_IMAGE_FEATURES += "tools-sdk"
#EXTRA_IMAGE_FEATURES += "tools-debug"
EXTRA_IMAGE_FEATURES += "package-management"

IMAGE_FSTYPES = "wic"

LICENSE_FLAGS_WHITELIST = "commercial"

RPI_USE_U_BOOT = "1"

ENABLE_SPI_BUS = "1"
ENABLE_I2C = "1"
ENABLE_UART = "1"

RPI_EXTRA_CONFIG = '\n\
kernel=Image\n\
arm_64bit=1\n\
'
```

## layers/meta-project-setup/conf/distro/rpizw-qemu.conf
```bitbake
require conf/distro/poky.conf

IMAGE_FEATURES:remove = "splash"
FEATURE_INSTALL:remove = "psplash-raspberrypi"
DISABLE_SPLASH = "1"
DISTRO_FEATURES:remove = " 3g bluetooth irda nfc x11 wayland"
DISTRO_FEATURES:append = " systemd wifi"
DISTRO_FEATURES_BACKFILL_CONSIDERED = "sysvinit"
INIT_MANAGER = "systemd"

#PREFERRED_PROVIDER_virtual/kernel = "linux-raspberrypi-rt"
#EXTRA_IMAGE_FEATURES += "debug-tweaks"
#EXTRA_IMAGE_FEATURES += "tools-sdk"
#EXTRA_IMAGE_FEATURES += "tools-debug"
EXTRA_IMAGE_FEATURES += "package-management"

LICENSE_FLAGS_WHITELIST = "commercial"

RPI_USE_U_BOOT = "1"

ENABLE_SPI_BUS = "1"
ENABLE_I2C = "1"
ENABLE_UART = "1"

RPI_EXTRA_CONFIG = '\n\
'
```

## layers/meta-swupdate-board-rpizw/conf/layer.conf
```bitbake
BBPATH := "${LAYERDIR}:${BBPATH}"

BBFILES += "${LAYERDIR}/recipes-*/*/*.bb ${LAYERDIR}/recipes-*/*/*.bbappend"
BBFILE_COLLECTIONS += "meta-swupdate-board-rpizw"
BBFILE_PATTERN_meta-swupdate-board-rpizw := "^${LAYERDIR}/"

BBFILE_PRIORITY_meta-swupdate-board-rpizw = "10"

LAYERSERIES_COMPAT_meta-swupdate-board-rpizw = "hardknott"

LAYERDEPENDS_meta-swupdate-board-rpizw = "swupdate-boards"

WKS_FILES_raspberrypi0-wifi = "raspberrypi0-wifi.wks"
IMAGE_FSTYPES += "wic"
```
