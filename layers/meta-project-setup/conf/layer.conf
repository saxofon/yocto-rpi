## layers/meta-project-setup/conf/layer.conf
```bitbake
BBPATH := "${LAYERDIR}:${BBPATH}"

BBFILES += "${LAYERDIR}/recipes-*/*/*.bb ${LAYERDIR}/recipes-*/*/*.bbappend"
BBFILE_COLLECTIONS += "meta-project-setup"
BBFILE_PATTERN_meta-project-setup := "^${LAYERDIR}/"

BBFILE_PRIORITY_meta-project-setup = "10"

LAYERSERIES_COMPAT_meta-project-setup = "scarthgap"

LAYERDEPENDS_meta-project-setup = ""

DISTRO = "rpi"

RPI_USE_U_BOOT = "1"
#IMAGE_FSTYPES = "rpi-sdimg ext4.gz"
#PREFERRED_PROVIDER_u-boot-fw-utils = "libubootenv"

#DISTRO_FEATURES += "ipv4 wifi"
```

## layers/meta-sbom-cve/conf/layer.conf
```bitbake
BBPATH := "${LAYERDIR}:${BBPATH}"

BBFILES += "${LAYERDIR}/recipes-*/*/*.bb ${LAYERDIR}/recipes-*/*/*.bbappend"
BBFILE_COLLECTIONS += "meta-sbom-cve"
BBFILE_PATTERN_meta-sbom-cve := "^${LAYERDIR}/"

BBFILE_PRIORITY_meta-sbom-cve = "10"

LAYERSERIES_COMPAT_meta-sbom-cve = "scarthgap"

LAYERDEPENDS_meta-sbom-cve = ""

INHERIT += "create-spdx"
SPDX_INCLUDE_SOURCES = "1"
SPDX_ARCHIVE_SOURCES = "1"
SPDX_ARCHIVE_PACKAGED = "0"

INHERIT += "cve-check"
```
